## sdkconfig.defaults.esp32c3
```kconfig
CONFIG_ESPTOOLPY_FLASHFREQ_40M=y
CONFIG_ESPTOOLPY_FLASHFREQ="40m"
CONFIG_ESPTOOLPY_FLASHMODE_DIO=y
CONFIG_ESPTOOLPY_FLASHMODE="dio"

# Hardware Protection (ESP32-C3)
CONFIG_ESP32C3_BROWNOUT_DET=y
```

## sdkconfig.defaults.esp32s3
```kconfig
CONFIG_ESPTOOLPY_FLASHFREQ_80M=y
CONFIG_ESPTOOLPY_FLASHFREQ="80m"
CONFIG_ESPTOOLPY_FLASHMODE_QIO=y
CONFIG_ESPTOOLPY_FLASHMODE="qio"

# Hardware Protection (ESP32-S3)
CONFIG_ESP32S3_BROWNOUT_DET=y
```
